## main/Kconfig.projbuild
```kconfig
menu "System Dashboard"

    config DASHBOARD_WIFI_SSID
        string "WiFi SSID"
        default "Xiaomi_185E"
        help
            WiFi network name used by the dashboard SNTP clock.

    config DASHBOARD_WIFI_PASSWORD
        string "WiFi password"
        default "sy.315210"
        help
            WiFi password used by the dashboard SNTP clock.

    config DASHBOARD_HOSTNAME
        string "WiFi hostname"
        default "fnos-dashboard"
        help
            Hostname advertised by the dashboard network interface.

    config DASHBOARD_STATIC_IP
        string "Static IPv4 address"
        default "192.168.1.222"
        help
            Static IPv4 address for the dashboard. Leave empty to use DHCP.

    config DASHBOARD_GATEWAY
        string "IPv4 gateway"
        default "192.168.1.1"
        help
            Gateway used when static IPv4 is enabled.

    config DASHBOARD_NETMASK
        string "IPv4 netmask"
        default "255.255.255.0"
        help
            Netmask used when static IPv4 is enabled.

    config DASHBOARD_DNS
        string "IPv4 DNS server"
        default "192.168.1.1"
        help
            DNS server used when static IPv4 is enabled.

    config DASHBOARD_TIMEZONE
        string "Timezone"
        default "CST-8"
        help
            POSIX timezone string. China Standard Time is CST-8.

    config DASHBOARD_SNTP_SERVER
        string "SNTP server"
        default "pool.ntp.org"
        help
            SNTP server used to synchronize local time.

    config DASHBOARD_MQTT_URI
        string "MQTT broker URI"
        default "mqtt://192.168.1.214:1883"
        help
            MQTT broker URI, for example mqtt://192.168.1.10:1883. Leave empty to keep mock data.

    config DASHBOARD_MQTT_USERNAME
        string "MQTT username"
        default "esp32"

    config DASHBOARD_MQTT_PASSWORD
        string "MQTT password"
        default "passwd"

    config DASHBOARD_MQTT_CLIENT_ID
        string "MQTT client id"
        default "fnos-dashboard"

    config DASHBOARD_MQTT_FNOS_CPU_TOPIC
        string "FnOS CPU MQTT topic"
        default "esp32/fnos/cpu/state"

    config DASHBOARD_MQTT_FNOS_MEM_TOPIC
        string "FnOS MEM MQTT topic"
        default "esp32/fnos/mem/state"

    config DASHBOARD_MQTT_FNOS_GPU_TOPIC
        string "FnOS GPU MQTT topic"
        default "esp32/fnos/gpu/state"

    config DASHBOARD_MQTT_FNOS_TX_TOPIC
        string "FnOS TX MQTT topic"
        default "esp32/fnos/tx/state"

    config DASHBOARD_MQTT_FNOS_RX_TOPIC
        string "FnOS RX MQTT topic"
        default "esp32/fnos/rx/state"

    config DASHBOARD_MQTT_WIN_CPU_TOPIC
        string "Windows11 CPU MQTT topic"
        default "esp32/windows11/cpu/state"

    config DASHBOARD_MQTT_WIN_MEM_TOPIC
        string "Windows11 MEM MQTT topic"
        default "esp32/windows11/mem/state"

    config DASHBOARD_MQTT_WIN_GPU_TOPIC
        string "Windows11 GPU MQTT topic"
        default "esp32/windows11/gpu/state"

    config DASHBOARD_MQTT_WIN_TX_TOPIC
        string "Windows11 TX MQTT topic"
        default "esp32/windows11/tx/state"

    config DASHBOARD_MQTT_WIN_RX_TOPIC
        string "Windows11 RX MQTT topic"
        default "esp32/windows11/rx/state"

    config DASHBOARD_MQTT_WEATHER_TOPIC
        string "DIAL weather MQTT topic"
        default "esp32/dial/weather/state"

    config DASHBOARD_PHOTO_URL
        string "Photo RGB565 HTTP URL"
        default "http://192.168.1.212:8000/image.rgb565"
        help
            HTTP endpoint that returns one 466x466 RGB565 photo frame.

    config DASHBOARD_PHOTO_REFRESH_MS
        int "Photo refresh interval in ms"
        default 300000
        help
            Interval for downloading a new photo. 300000 ms is 5 minutes.

endmenu
```

## sdkconfig.defaults.local.example
```kconfig
# Copy this file to `sdkconfig.defaults.local` for private machine-specific
# settings. The local file is gitignored and can safely contain credentials.
#
# Example:
#   idf.py -D SDKCONFIG_DEFAULTS="sdkconfig.defaults;sdkconfig.defaults.local" build

CONFIG_DASHBOARD_WIFI_SSID="YOUR_WIFI_SSID"
CONFIG_DASHBOARD_WIFI_PASSWORD="YOUR_WIFI_PASSWORD"
CONFIG_DASHBOARD_HOSTNAME="fnos-dashboard"
CONFIG_DASHBOARD_STATIC_IP="192.168.1.222"
CONFIG_DASHBOARD_GATEWAY="192.168.1.1"
CONFIG_DASHBOARD_NETMASK="255.255.255.0"
CONFIG_DASHBOARD_DNS="192.168.1.1"
CONFIG_DASHBOARD_TIMEZONE="CST-8"
CONFIG_DASHBOARD_SNTP_SERVER="pool.ntp.org"
CONFIG_DASHBOARD_MQTT_URI="mqtt://192.168.1.214:1883"
CONFIG_DASHBOARD_MQTT_USERNAME="YOUR_MQTT_USERNAME"
CONFIG_DASHBOARD_MQTT_PASSWORD="YOUR_MQTT_PASSWORD"
CONFIG_DASHBOARD_MQTT_CLIENT_ID="fnos-dashboard"
CONFIG_DASHBOARD_MQTT_FNOS_CPU_TOPIC="esp32/fnos/cpu/state"
CONFIG_DASHBOARD_MQTT_FNOS_MEM_TOPIC="esp32/fnos/mem/state"
CONFIG_DASHBOARD_MQTT_FNOS_GPU_TOPIC="esp32/fnos/gpu/state"
CONFIG_DASHBOARD_MQTT_FNOS_TX_TOPIC="esp32/fnos/tx/state"
CONFIG_DASHBOARD_MQTT_FNOS_RX_TOPIC="esp32/fnos/rx/state"
CONFIG_DASHBOARD_MQTT_WIN_CPU_TOPIC="esp32/windows11/cpu/state"
CONFIG_DASHBOARD_MQTT_WIN_MEM_TOPIC="esp32/windows11/mem/state"
CONFIG_DASHBOARD_MQTT_WIN_GPU_TOPIC="esp32/windows11/gpu/state"
CONFIG_DASHBOARD_MQTT_WIN_TX_TOPIC="esp32/windows11/tx/state"
CONFIG_DASHBOARD_MQTT_WIN_RX_TOPIC="esp32/windows11/rx/state"
CONFIG_DASHBOARD_MQTT_WEATHER_TOPIC="esp32/dial/weather/state"
CONFIG_DASHBOARD_PHOTO_URL="http://192.168.1.212:8000/image.rgb565"
```
